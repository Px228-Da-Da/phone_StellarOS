/*
 * Раскладка пользовательской программы.
 *
 * Адреса те же, что ядро отображает каждой программе (см. uspace.c):
 *
 *   0x1000000000   код и постоянные данные — читать и исполнять
 *   0x1000080000   изменяемые данные       — читать и писать
 *   0x1000100000   стек
 *   0x1000200000   окно, если попросит
 *
 * Программа линкуется по фиксированному адресу, а не позиционно
 * независимо: ядро кладёт её ровно туда, и городить относительную
 * адресацию незачем.
 */
ENTRY(_start)

SECTIONS
{
    . = 0x0000001000000000;

    .text : {
        KEEP(*(.text.start))    /* точка входа обязана быть первой */
        *(.text .text.*)
        *(.rodata .rodata.*)
    }

    /*
     * Изменяемые данные лежат по своему адресу и в образ НЕ попадают:
     * ядро выдаёт под них чистые страницы.
     *
     * Отсюда правило: у пользовательских программ не бывает
     * инициализированных глобальных переменных. Их значения пришлось бы
     * откуда-то копировать при запуске, а копировать неоткуда — образ
     * содержит только код. Проверку ставим прямо здесь, чтобы это
     * выяснялось при сборке, а не по молчаливо нулевой переменной.
     */
    . = 0x0000001000080000;

    .data : { *(.data .data.*) }
    ASSERT(SIZEOF(.data) == 0,
           "у программы для EL0 не может быть инициализированных глобальных переменных")

    .bss : { *(.bss .bss.*) *(COMMON) }
    ASSERT(SIZEOF(.bss) <= 0x10000,
           "изменяемых данных больше, чем ядро отображает программе (64 КБ)")

    /DISCARD/ : { *(.comment) *(.note.*) *(.eh_frame*) }
}
